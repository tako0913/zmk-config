## boards/shields/Ilios/Kconfig.defconfig
```kconfig
if SHIELD_Ilios_LEFT

config ZMK_KEYBOARD_NAME
    default "Ilios"

config ZMK_SPLIT_ROLE_CENTRAL
    default y

endif

if SHIELD_Iliod_LEFT || SHIELD_Iliod_RIGHT

config ZMK_SPLIT
    default y

endif
```

## boards/shields/Ilios/Kconfig.shield
```kconfig
config SHIELD_Ilios_LEFT
    def_bool $(shields_list_contains,Ilios_left)

config SHIELD_Ilios_RIGHT
    def_bool $(shields_list_contains,Ilios_right)
```
